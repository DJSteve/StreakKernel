## drivers/i2c/chips/Kconfig
```kconfig
#
# Miscellaneous I2C chip drivers configuration
#
# *** DEPRECATED! Do not add new entries! See Makefile ***
#

menu "Miscellaneous I2C Chip support"

config DS1682
	tristate "Dallas DS1682 Total Elapsed Time Recorder with Alarm"
	depends on EXPERIMENTAL
	help
	  If you say yes here you get support for Dallas Semiconductor
	  DS1682 Total Elapsed Time Recorder.

	  This driver can also be built as a module.  If so, the module
	  will be called ds1682.

config SENSORS_TSL2550
	tristate "Taos TSL2550 ambient light sensor"
	depends on EXPERIMENTAL
	help
	  If you say yes here you get support for the Taos TSL2550
	  ambient light sensor.

	  This driver can also be built as a module.  If so, the module
	  will be called tsl2550.

config SENSORS_AKM8976
	tristate "AKM8976 Compass Driver"
	depends on I2C
	help
	 AKM8976 Compass Driver implemented by HTC.

config SENSORS_AKM8973
	tristate "AKM8973 Compass Driver"
	depends on I2C
	help
	 AKM8973 Compass Driver implemented by HTC.

config SENSORS_PCA963X
	tristate "Philips PCA963X 4-bit I2C-bus LED"
	depends on I2C && EXPERIMENTAL
	help
	 If you say yes here you get support for the Philips PCA963X
	 4-bit I2C-bus LED.

	 This driver can also be built as a module.  If so, the module
	 will be called pca963X.

config SENSORS_MT9T013
	tristate "MT9T013 Camera Driver"
	depends on I2C
	default y
	help
	 MT9T013 Camera Driver implemented by HTC.

config VP_A1026
	tristate "A1026 Voice Processor Driver"
	depends on I2C
	help
	  A1026 Voice Processor Driver implemented by HTC.

# Austin_CR #:XXX, WH Lee, 20081204. Support G-sensor
config GSENSOR_BOSCH_BMA150
	tristate "Bosch BMA150 accelerometer with using I2C interface"
	default y
	help
	  Say Y here if you want support for the BMA150 accelerometer
	  device.

	  To compile this driver as a module, choose M here: the
	  module will be called gsensor-bosch-bma150.

# Austin_CR #:XXX, WH Lee, 20081205. Support E-compass
config ECOMPASS_AKM_AK8973S
	tristate "AKM AK8973S geomagnetism detection with using I2C interface"
	default y
	help
	  Say Y here if you want support for the  AK8973S geomagnetism
	  detection device.

	  To compile this driver as a module, choose M here: the
	  module will be called ecompass-akm-ak8973s.

config BCOM_FM
	tristate "Broadcom FM"
        depends on I2C
	default n
	help
	  Broadcom 4325 FM I2C driver

endmenu
```
